################################################################################
#                                                                              #
#                                 sampleint.S                                  #
#                      Handles new samples and triggering                      #
#                                   EE/CS 52                                   #
#                                                                              #
################################################################################


/*
 *  Albert Gural
 *  EE/CS 52
 *  TA: Dan Pipe-Mazo
 *
 *  File Description:	This file contains functions for handling
 *  interrupts generated by new triggered samples, and provides
 *  the accessor functions for the main C code to access the sampled 
 *  data. Samples are stored in a char** buffer first indexed by which
 *  input (A, B, logic analyzer), then indexed by the samples.
 *
 *  Revision History:
 *      02/09/2012  Dan Pipe-Mazo	Initial Revision.
 *		05/14/2014	Albert Gural	Begain writing adc code assembly.
 *		06/02/2014  Albert Gural 	Added accessor functions for C code interface.
 *
 */

 /*  Local Include Files   */
#include "macros.m"
#include "pio.m"
#include "../osc_bsp/system.h"

.section  .text         #start code section


/*
 *  adc_int_installer
 *
 *  Description: Installs the interrupt handler for trigger interrupts.
 *
 *  Arguments: (none)
 *
 *  Return Value: (none)
 *
 */

.global adc_int_installer
.type	adc_int_installer, @function

adc_int_installer:
	SAVE

	# Install the interrupt handler
	mov		r4, r0
	movi	r5, 6
	MOVWI	r6, adc_int_handler
	mov		r7, r0
	PUSH	r0
	call	alt_ic_isr_register
	POP		r0

	# Clear the edge capture register (write 1 to clear).
	MOVWI	r8, TRIG_INT_BASE
	MOVWI	r9, 0xFFFFFFFF
	stw		r9, PIO_EDGE_CAP(r8)

adc_int_installer_done:
	RESTORE
	ret


/*
 *  adc_int_handler
 *
 *  Description: Handles a trigger interrupt. When a trigger occurs, we need
 *  to move all the data from the FIFO onto a local buffer (which can then be
 *	used by the C code in higher level functions).
 *
 *  Arguments: (none)
 *
 *  Return Value: (none)
 *
 */

.global adc_int_handler
.type adc_int_handler, @function

adc_int_handler:
	SAVE

	# Clear interrupts.
	MOVWI	r8, TRIG_INT_BASE
	stw		r0, PIO_IRQ_MASK(r8)

	# Get the edge capture register.
	ldw		r9, PIO_EDGE_CAP(r8)

	# Pause FIFO write.
	STWI	ADC_CTRL_BASE, 0x00

	# Loop variable to clear front of fifo
	mov		r10, r0

	# Set specially-designed delay offsets based on which fifo source clock is being used.
	movia	r8, fifo_clk_src
	ldb		r9, (r8)
	beq		r9, r0, adc_int_handler_fast_clk_offset

adc_int_handler_1M_clk_offset:
	movi	r13, 15
	br		adc_int_handler_clear_front

adc_int_handler_fast_clk_offset:
	movi	r13, 22

adc_int_handler_clear_front:
	# Bitbang clock pulse.
	STWI	ADC_CTRL_BASE, 0x01
	STWI	ADC_CTRL_BASE, 0x00

	# Keep going until 480 good remaining points (for display)
	addi	r10, r10, 1
	bltu	r10, r13, adc_int_handler_clear_front

	movia	r8, sample_buffer_A
	mov		r10, r0

adc_int_handler_loop:
	# Bitbang clock pulse.
	STWI	ADC_CTRL_BASE, 0x01
	STWI	ADC_CTRL_BASE, 0x00

	# Get ch. A, ch. B, and logic data.
	MOVWI	r11, ADC_RAW_BASE
	ldwio	r12, (r11)

	# r12 for ch. A, r13 for ch. B, r14 for logic.
	srli	r13, r12, 8
	srli	r14, r13, 8
	movui	r15, 128

	# Convert analog channels to non-signed values.
	add		r12, r12, r15
	add		r13, r13, r15

	# Keep only the bottom byte.
	andi	r12, r12, 0xFF
	andi	r13, r13, 0xFF
	andi	r14, r14, 0xFF

	# CH. A
	# Retrieve the current buffer contents.
	# Then update the current buffer with the new value.
	movia	r8, sample_buffer_A
	add		r8, r8, r10
	stb		r12, (r8)

	# CH. B
	# Retrieve the current buffer contents.
	# Then update the current buffer with the new value.
	movia	r8, sample_buffer_B
	add		r8, r8, r10
	stb		r13, (r8)

	# LOGIC ANALYZER
	# Retrieve the current buffer contents.
	# Then update the current buffer with the new value.
	movia	r8, sample_buffer_L
	add		r8, r8, r10
	stb		r14, (r8)

	addi	r10, r10, 1
	movi	r15, 480
	bltu	r10, r15, adc_int_handler_loop

	# Sample done.
	movia	r8, sample_complete
	movi	r9, 1
	stb		r9, (r8)

adc_int_handler_done:

	RESTORE
	ret



/*
 *  clear_display
 *
 *  Description: Clears the display.
 *
 *  Arguments: (none)
 *
 *  Return Value: (none)
 *
 */

.global clear_display
.type clear_display, @function

clear_display:
	SAVE

	# Get display address and background color.
	MOVWI	r8, VRAM_CTRL_BASE
	movui	r9, 272
	slli	r9, r9, 10
	add		r9, r8, r9
	movui	r15, 0x001C

	# Loop over all screen pixels, clearing them.
clear_display_loop:
	sthio 	r15, (r8)
	addi	r8, r8, 2
	bltu	r8, r9, clear_display_loop

clear_display_done:
	RESTORE
	ret



/*
 *  plot_pixel
 *
 *  Description: Plots a pixel of the specified color at the specified location.
 *
 *  Arguments:
 *  r4 - The x coordinate (from left)
 *  r5 - The y coordinate (from top)
 *  r6 - The color
 *
 *  Return Value: (none)
 *
 */

.global plot_pixel
.type plot_pixel, @function

plot_pixel:
	SAVE

	push	r4
	push	r5

	# Each row takes 1024 bytes, so shift row var by 10 bits.
	slli	r5, r5, 10
	# Add twice to account for 16-bit VRAM storage.
	add		r5, r5, r4
	add		r5, r5, r4
	# Now get the absolute address.
	MOVWI	r4, VRAM_CTRL_BASE
	add		r5, r5, r4
	# Store the color.
	sth		r6, (r5)

	pop		r5
	pop		r4

plot_pixel_done:
	RESTORE
	ret


/*
 *  set_sample_rate
 *
 *  Description: Given the desired sample frequency, computes what compare value
 *  value would be needed on the FIFO sample clock to get that frequency. The
 *  computed value is sent to the control register.
 *
 *  Arguments:
 *  r4 - The desired frequency (Hz)
 *
 *  Return Value: (none)
 *
 */

.global set_sample_rate
.type set_sample_rate, @function

set_sample_rate:
	SAVE

	MOVWI	r9, 100000
	bleu	r4, r9, slow_sample_rate

fast_sample_rate:
	# Divide fastest sample rate by desired sample rate
	# to get number of ticks to pause (not collect samples)
	# between collecting samples.
	MOVWI	r8, ADC_RATE_BASE
	MOVWI	r9, 400000000
	divu	r9, r9, r4
	subi	r9, r9, 1
	stw		r9, (r8)

	# Set fast clock for FIFO clock counter.
	MOVWI	r8, TRIG_CTRL_BASE
	MOVWI	r9, 0x00000080
	stw		r9, PIO_OUTCLR(r8)

	# Update fifo source flag.
	movia	r8, fifo_clk_src
	stb		r0, (r8)

	br		set_sample_rate_done

slow_sample_rate:
	# Divide fastest sample rate by desired sample rate
	# to get number of ticks to pause (not collect samples)
	# between collecting samples.
	MOVWI	r8, ADC_RATE_BASE
	MOVWI	r9, 1000000
	divu	r9, r9, r4
	subi	r9, r9, 1
	stw		r9, (r8)

	# Set 1MHz clock for FIFO clock counter.
	MOVWI	r8, TRIG_CTRL_BASE
	MOVWI	r9, 0x00000080
	stw		r9, PIO_OUTSET(r8)

	# Update fifo source flag.
	movia	r8, fifo_clk_src
	movi	r9, 1
	stb		r9, (r8)

set_sample_rate_done:
	# Always return 480 samples.
	movui	r2, 480

	RESTORE
	ret


/*
 *  set_trigger
 *
 *  Description: Sets the trigger level (7 bit precision) and slope.
 *
 *  Arguments:
 *  r4 - Trigger level
 *  r5 - Slope
 *
 *  Return Value: (none)
 *
 */

.global set_trigger
.type set_trigger, @function

set_trigger:
	SAVE

	# Convert [0 to 127] to signed 8-bit [-127 to 127].
	# Then update trigger level.
	MOVWI	r8, TRIG_LEVEL_BASE
	slli	r9, r4, 1
	subi	r9, r9, 127
	andi	r9, r9, 0xFF
	stw		r9, (r8)

	# Slope is second bit of TRIG_CTRL. Modify the given
	# argument, then update slope.
	beq		r5, r0, set_trigger_slope_pos
	movi	r8, 0x02
	MOVWI	r9, TRIG_CTRL_BASE
	stw		r8, PIO_OUTSET(r9)
	br		set_trigger_done

set_trigger_slope_pos:
	movi	r8, 0x02
	MOVWI	r9, TRIG_CTRL_BASE
	stw		r8, PIO_OUTCLR(r9)

set_trigger_done:
	RESTORE
	ret


/*
 *  set_delay
 *
 *  Description: Sets the delay (positive or negative)
 *
 *  Arguments:
 *  r4 - Delay in samples
 *
 *  Return Value: (none)
 *
 */

.global set_delay
.type set_delay, @function

set_delay:
	SAVE

	# Simply set the delay (240 offset means delay 0 is in the middle).
	addi	r9, r4, 240
	MOVWI	r8, TRIG_DELAY_BASE
	stw		r9, (r8)

set_delay_done:
	RESTORE
	ret


/*
 *  start_sample
 *
 *  Description: Prepares the FPGA logic for finding the next trigger event.
 *
 *  Arguments:
 *  r4 - Type of trigger (0 for normal, 1 for auto-trigger)
 *
 *  Return Value: (none)
 *
 */

.global start_sample
.type start_sample, @function

start_sample:
	SAVE

	# Clear the edge capture register (write 1 to clear).
	MOVWI	r8, TRIG_INT_BASE
	MOVWI	r9, 0xFFFFFFFF
	stw		r9, PIO_EDGE_CAP(r8)

	# Enable trigger interrupts.
	MOVWI	r9, 0x00000002
	# If auto-trigger, enable time-outs as well.
	slli	r8, r4, 2
	add		r9, r8, r9

	MOVWI	r8, TRIG_INT_BASE
	stw		r9, PIO_IRQ_MASK(r8)

	# Clear FIFO, turn on FIFO write.
	STWI	ADC_CTRL_BASE, 0x04
	STWI	ADC_CTRL_BASE, 0x02

	# Restart trigger counter [ch. A], [+ slope]
	MOVWI	r8, TRIG_CTRL_BASE
	movi	r9, 1
	stw		r9, PIO_OUTSET(r8)
	stw		r9, PIO_OUTCLR(r8)

start_sample_done:
	RESTORE
	ret


/*
 *  sample_done
 *
 *  Description: Returns a pointer to the sample buffer, which is an array
 *  of an array of samples. If the sample is not done, returns null.
 *
 *  Arguments: (none)
 *
 *  Return Value: Pointer to the buffer, or null if the sample is not finished
 *
 */

.global sample_done
.type sample_done, @function

sample_done:
	SAVE

	# Test if sample occurred.
	movia	r8, sample_complete
	ldb		r9, (r8)
	beq		r9, r0, sample_null

	# If so, reset sample complete variable and return map to buffers.
	stb		r0, (r8)
	movia	r2, sample_map
	br		sample_done_done

sample_null:
	# Otherwise, return null.
	mov		r2, r0

sample_done_done:
	RESTORE
	ret


/*
 * Contains the three sample buffers. In this way, sample_map is an array of an array of samples,
 * or a char**. The first index [0..2] gives which input we want, while the second index [0..479]
 * gives which sample we want.
 *
 */

sample_map:
	.word	sample_buffer_A
	.word	sample_buffer_B
	.word	sample_buffer_L


.section  .data     #start data section

sample_complete:	.word	0		# 0 = still trying to get sample; 1 = sample done.
fifo_clk_src:		.word	0		# 0 = fast_clk, 1 = 1M_clk. This is useful for fine-tuning the trigger delay.
sample_buffer_A:	.skip	480		# Buffer stores display-worth of ADC samples (ch. A).
sample_buffer_B:	.skip	480		# Buffer stores display-worth of ADC samples (ch. B).
sample_buffer_L:	.skip	480		# Buffer stores display-worth of ADC samples (Logic).
